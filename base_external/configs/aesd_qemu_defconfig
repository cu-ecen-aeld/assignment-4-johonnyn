## base_external/configs/aesd_qemu_defconfig
```kconfig
BR2_aarch64=y
BR2_TARGET_GENERIC_ROOT_PASSWD="root"
BR2_LINUX_KERNEL=y
BR2_LINUX_KERNEL_USE_ARCH_DEFAULT_CONFIG=y
# Ensure virtio networking is enabled for QEMU
BR2_LINUX_KERNEL_CONFIG_FRAGMENT_FILES="$(BR2_EXTERNAL_aesd_assignments_PATH)/kernel-virtio.config"
BR2_PACKAGE_DROPBEAR=y
BR2_PACKAGE_DHCPCD=y
BR2_TARGET_ROOTFS_EXT2=y
BR2_TARGET_ROOTFS_EXT2_4=y
BR2_TARGET_ROOTFS_EXT2_SIZE="120M"
BR2_PACKAGE_AESD_ASSIGNMENTS=y
```
